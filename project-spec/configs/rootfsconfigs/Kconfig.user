## project-spec/configs/rootfsconfigs/Kconfig.user
```kconfig
menu "user packages " 
config gpio-demo  
	 bool "gpio-demo"
	 help
	
config hello-world  
	 bool "hello-world"
	 help
	
config peekpoke  
	 bool "peekpoke"
	 help
	
config python-rs232  
	 bool "python-rs232"
	 help
	
config rs232-c  
	 bool "rs232-c"
	 help
	
config std1553-ste  
	 bool "std1553-ste"
	 help
	
config translator  
	 bool "translator"
	 help
	
config translator-dbg  
	 bool "translator-dbg"
	 help
	
config translator-dev  
	 bool "translator-dev"
	 help
	
endmenu
```
