## components/yocto/layers/meta-petalinux/conf/distro/include/petalinux-version.conf
```bitbake
# Main release version
XILINX_VER_MAIN = "2025.2"

# Set to "release" for major releases and "update-1" for update releases
XILINX_VER_UPDATE = "release"

# This will be set in local.conf for CI builds
XILINX_VER_BUILD ?= "S11151021"

# Petalinux version
PETALINUX_VERSION = "${XILINX_VER_MAIN}"
```
